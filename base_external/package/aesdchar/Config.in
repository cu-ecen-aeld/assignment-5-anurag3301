## base_external/package/aesdchar/Config.in
```kconfig
config BR2_PACKAGE_AESDCHAR
	bool "aesdchar"
    depends on BR2_LINUX_KERNEL
	help
        Addes the misc-modules and scull kernel modules from ldd
```

## base_external/package/ldd/Config.in
```kconfig
config BR2_PACKAGE_LDD
	bool "ldd"
    depends on BR2_LINUX_KERNEL
	help
        Addes the misc-modules and scull kernel modules from ldd
```
